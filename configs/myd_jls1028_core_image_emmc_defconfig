## configs/myd_jls1028_core_image_emmc_defconfig
```kconfig
# Architecture
BR2_aarch64=y
BR2_cortex_a72=y

# Filesystem
BR2_TARGET_ROOTFS_EXT2=y
BR2_TARGET_ROOTFS_EXT2_4=y
BR2_ROOTFS_RESIZE=y

# Hostname and issue
BR2_TARGET_GENERIC_HOSTNAME="MYD-JLS1028"
BR2_TARGET_GENERIC_ISSUE="Welcome to OpenIL"

# toolchain
BR2_TOOLCHAIN_EXTERNAL=y
BR2_TOOLCHAIN_EXTERNAL_ARM_AARCH64=y
BR2_TOOLCHAIN_USES_GLIBC=y
BR2_TOOLCHAIN_EXTERNAL_GLIBC=y
BR2_DL_DIR="/home/qinlh/media_qinlh/nxp/buildroot/dl"
# Linux headers same as kernel
BR2_PACKAGE_HOST_LINUX_HEADERS_CUSTOM_5_4=y

# bootloader
BR2_TARGET_UBOOT=y
BR2_TARGET_UBOOT_CUSTOM_REPO_URL="/home/qinlh/media_qinlh/nxp/LSDK-20.12/u-boot/.git"
BR2_TARGET_UBOOT_CUSTOM_REPO_VERSION="myd-jls1028"
BR2_TARGET_UBOOT_VERSION="myd-jls1028"
BR2_TARGET_UBOOT_BOARDNAME="myd_jls1028_tfa"
BR2_TARGET_UBOOT_CUSTOM_GIT=y
BR2_TARGET_UBOOT_NEEDS_DTC=y
BR2_TARGET_UBOOT_FORMAT_BIN=n
BR2_TARGET_UBOOT_FORMAT_CUSTOM=y
BR2_TARGET_UBOOT_FORMAT_CUSTOM_NAME="u-boot-dtb.bin"
BR2_PACKAGE_UBOOT_TOOLS_MKIMAGE=y
BR2_TARGET_UBOOT_ENVIMAGE=y
BR2_TARGET_UBOOT_ENVIMAGE_SOURCE="board/myir/myd-jls1028/u-boot-environment-emmc.txt"
BR2_TARGET_UBOOT_ENVIMAGE_SIZE="0x2000"

# Kernel
BR2_LINUX_KERNEL=y
BR2_LINUX_KERNEL_CUSTOM_GIT=y
BR2_LINUX_KERNEL_CUSTOM_REPO_URL="/home/qinlh/media_qinlh/nxp/rt-linux/.git"
BR2_LINUX_KERNEL_CUSTOM_REPO_VERSION="linux-5.4.y"
BR2_LINUX_KERNEL_VERSION="linux-5.4.y"
BR2_LINUX_KERNEL_USE_ARCH_DEFAULT_CONFIG=y
BR2_LINUX_KERNEL_CONFIG_FRAGMENT_FILES="$(LINUX_DIR)/arch/arm64/configs/lsdk.config"
BR2_LINUX_KERNEL_DTS_SUPPORT=y
BR2_LINUX_KERNEL_INTREE_DTS_NAME="freescale/myd-jls1028"
BR2_LINUX_KERNEL_IMAGE_TARGET_CUSTOM=y
BR2_LINUX_KERNEL_IMAGE_TARGET_NAME="Image"
BR2_LINUX_KERNEL_NEEDS_HOST_OPENSSL=y

# Serial port config
BR2_TARGET_GENERIC_GETTY=y
BR2_TARGET_GENERIC_GETTY_PORT="ttyS0"

# required tools to create the microSD image
BR2_PACKAGE_HOST_DOSFSTOOLS=y
BR2_PACKAGE_HOST_GENIMAGE=y
BR2_PACKAGE_HOST_MTOOLS=y
BR2_ROOTFS_POST_IMAGE_SCRIPT="board/myir/myd-jls1028/post-image.sh"
BR2_ROOTFS_POST_SCRIPT_ARGS="$(LINUX_DIR) $(TOPDIR) $(UBOOT_DIR)"

# busybox setting
BR2_PACKAGE_BUSYBOX_CONFIG_FRAGMENT_FILES="board/myir/common/ls/busybox.config"
BR2_PACKAGE_BUSYBOX_SHOW_OTHERS=y

# packages for rcw
BR2_PACKAGE_HOST_QORIQ_RCW=y
BR2_PACKAGE_HOST_QORIQ_RCW_BOOT_MODE="emmc"
BR2_PACKAGE_HOST_QORIQ_RCW_BIN="myd_jls1028/R_SQPP_0x85bb/rcw_1500_gpu600.bin"
BR2_PACKAGE_HOST_QORIQ_RCW_SITE="/home/qinlh/media_qinlh/nxp/LSDK-20.12/rcw/.git"
BR2_PACKAGE_HOST_QORIQ_RCW_VERSION="myd-jls1028"

#eudev support
BR2_ROOTFS_DEVICE_CREATION_DYNAMIC_EUDEV=y
BR2_ROOTFS_OVERLAY="board/myir/myd-jls1028/rootfs_overlay board/myir/common/ls/busybox_init_overlay"

# Arm-Trusted-Firmware
BR2_TARGET_ARM_TRUSTED_FIRMWARE=y
BR2_TARGET_ARM_TRUSTED_FIRMWARE_FIP=y
BR2_TARGET_ARM_TRUSTED_FIRMWARE_UBOOT_AS_BL33=y
BR2_TARGET_ARM_TRUSTED_FIRMWARE_UBOOT_BL33_IMAGE="u-boot-dtb.bin"
BR2_TARGET_ARM_TRUSTED_FIRMWARE_CUSTOM_GIT=y
BR2_TARGET_ARM_TRUSTED_FIRMWARE_VERSION="myd-jls1028"
BR2_TARGET_ARM_TRUSTED_FIRMWARE_CUSTOM_REPO_URL="/home/qinlh/media_qinlh/nxp/LSDK-20.12/atf/.git"
BR2_TARGET_ARM_TRUSTED_FIRMWARE_CUSTOM_REPO_VERSION="myd-jls1028"
BR2_TARGET_ARM_TRUSTED_FIRMWARE_PLATFORM="myd_jls1028"
BR2_TARGET_ARM_TRUSTED_FIRMWARE_IMAGES="fip.bin bl2_emmc.pbl"
BR2_TARGET_ARM_TRUSTED_FIRMWARE_ADDITIONAL_TARGETS="pbl"
BR2_TARGET_ARM_TRUSTED_FIRMWARE_ADDITIONAL_DEPENDENCIES="host-qoriq-rcw"
BR2_TARGET_ARM_TRUSTED_FIRMWARE_ADDITIONAL_VARIABLES="BOOT_MODE=emmc RCW=$(BINARIES_DIR)/rcw_1500_gpu600.bin"

#Display port firmware
BR2_PACKAGE_QORIQ_CADENCE_DP_FIRMWARE=y

# qoriq-ptp4l package
BR2_PACKAGE_QORIQ_PTP4L=y

# qoriq-tsntool
BR2_PACKAGE_CJSON=y
BR2_PACKAGE_QORIQ_TSNTOOL=y
BR2_PACKAGE_QORIQ_TSN_SCRIPTS=y





# qoriq-genavb-tsn-bridge
BR2_PACKAGE_QORIQ_GENAVB_TSN_BRIDGE=y



BR2_PACKAGE_LINUX_PAM=y
BR2_PACKAGE_PANGO=y
# sysrepo-tsn
# BR2_PACKAGE_OPENSSH=y # Already set in basic packages
BR2_PACKAGE_LIBSSH=y
BR2_PACKAGE_LIBSSH_SERVER=y
BR2_PACKAGE_QORIQ_SYSREPO_TSN=y

# basic packages and tools
BR2_PACKAGE_MTD=y
BR2_PACKAGE_MTD_MTD_DEBUG=y
BR2_PACKAGE_SYSSTAT=y
BR2_PACKAGE_E2FSPROGS=y
BR2_PACKAGE_RT_TESTS=y
BR2_PACKAGE_OPENSSH=y
BR2_PACKAGE_OPENSSL=y
BR2_PACKAGE_WGET=y

# ca-certs packages
BR2_PACKAGE_CA_CERTIFICATES=y

# dhcpd package
BR2_PACKAGE_DHCPCD=y
BR2_PACKAGE_DHCP=y
BR2_PACKAGE_DHCP_SERVER=y
# resize2fs package
BR2_PACKAGE_E2FSPROGS_RESIZE2FS=y

# Text editors
BR2_PACKAGE_NANO=y

# IGH ETHERCAT
BR2_PACKAGE_IGH_ETHERCAT=y

#iproute2
BR2_PACKAGE_IPROUTE2=y
BR2_PACKAGE_LIBMNL=y

#netperf
BR2_PACKAGE_NETPERF=y

BR2_PACKAGE_ETHTOOL=y
BR2_PACKAGE_COLLECTD_CURL=y
BR2_PACKAGE_COLLECTD_CURL_JSON=y
BR2_PACKAGE_COLLECTD_CURL_XML=y
BR2_PACKAGE_LIBCURL=y
BR2_PACKAGE_LIBCURL_CURL
BR2_PACKAGE_LIBCURL_VERBOSE=y
BR2_PACKAGE_FLICKCURL=y
BR2_PACKAGE_FLICKCURL_UTILS=y
BR2_PACKAGE_BASH=y
BR2_SYSTEM_BIN_SH_BASH=y
BR2_SYSTEM_BIN_SH="bash"


# haveged
BR2_PACKAGE_HAVEGED=y

#avahi
BR2_PACKAGE_AVAHI=y
BR2_PACKAGE_AVAHI_AUTOIPD=y
BR2_PACKAGE_AVAHI_DAEMON=y
BR2_PACKAGE_AVAHI_LIBDNSSD_COMPATIBILITY=y
BR2_PACKAGE_NSS_MDNS=y
# i2c-tools
BR2_PACKAGE_I2C_TOOLS=y
BR2_USE_MMU=y
BR2_USE_WCHAR=y


BR2_INSTALL_LIBSTDCPP=y


BR2_TOOLCHAIN_HAS_THREADS=y
BR2_PACKAGE_IPERF3=y
BR2_PACKAGE_TCPDUMP=y
BR2_PACKAGE_DROPWATCH=y


#MYIR add package
BR2_PACKAGE_ALSA_UTILS=y
BR2_PACKAGE_ALSA_UTILS_AMIXER=y
BR2_PACKAGE_ALSA_UTILS_APLAY=y
BR2_PACKAGE_GDB=y
BR2_PACKAGE_SPIDEV_TEST=y
BR2_PACKAGE_DOSFSTOOLS=y
BR2_PACKAGE_DOSFSTOOLS_MKFS_FAT=y
BR2_PACKAGE_GENEXT2FS=y
BR2_PACKAGE_MMC_UTILS=y
BR2_PACKAGE_NFS_UTILS=y
BR2_PACKAGE_EVTEST=y
BR2_PACKAGE_MEMTESTER=y
BR2_PACKAGE_MEMTOOL=y
BR2_PACKAGE_MINICOM=y
BR2_PACKAGE_UBOOT_TOOLS=y
BR2_PACKAGE_TSLIB=y
BR2_PACKAGE_BC=y
BR2_PACKAGE_BLUEZ_TOOLS=y
BR2_PACKAGE_BLUEZ5_UTILS=y
BR2_PACKAGE_BRIDGE_UTILS=y
BR2_PACKAGE_CAN_UTILS=y
BR2_PACKAGE_HOSTAPD=y
BR2_PACKAGE_IPTABLES=y
BR2_PACKAGE_LFTP=y
BR2_PACKAGE_OPENVPN=y
BR2_PACKAGE_PPPD=y
BR2_PACKAGE_PROFTPD=y
BR2_PACKAGE_TFTPD=y
BR2_PACKAGE_IW=y
BR2_PACKAGE_UTIL_LINUX_RFKILL=y
BR2_PACKAGE_WIRELESS_TOOLS=y
BR2_PACKAGE_WPA_SUPPLICANT=y
BR2_PACKAGE_WPA_SUPPLICANT_CLI=y
BR2_PACKAGE_WPA_SUPPLICANT_WPA_CLIENT_SO=y
BR2_PACKAGE_WPA_SUPPLICANT_PASSPHRASE=y
BR2_PACKAGE_PCIUTILS=y
BR2_PACKAGE_HOST_PYTHON3=y
BR2_PACKAGE_PYTHON3=y
BR2_PACKAGE_PYTHON3_BZIP2=y
BR2_PACKAGE_PYTHON3_READLINE=y
BR2_PACKAGE_PYTHON3_SSL=y
BR2_PACKAGE_PYTHON3_UNICODEDATA=y
BR2_PACKAGE_PYTHON3_PYEXPAT=y
BR2_PACKAGE_PYTHON3_ZLIB=y
BR2_PACKAGE_PYTHON_PIP=y
```

## configs/myd_jls1028_core_image_xspi_defconfig
```kconfig
# Architecture
BR2_aarch64=y
BR2_cortex_a72=y

# Filesystem
BR2_TARGET_ROOTFS_CPIO=y
BR2_TARGET_ROOTFS_CPIO_GZIP=y
BR2_TARGET_ROOTFS_CPIO_UIMAGE=y

# Hostname and issue
BR2_TARGET_GENERIC_HOSTNAME="MYD-JLS1028"
BR2_TARGET_GENERIC_ISSUE="Welcome to OpenIL"

# toolchain
BR2_TOOLCHAIN_EXTERNAL=y
BR2_TOOLCHAIN_EXTERNAL_ARM_AARCH64=y
BR2_TOOLCHAIN_USES_GLIBC=y
BR2_TOOLCHAIN_EXTERNAL_GLIBC=y
BR2_DL_DIR="/home/qinlh/media_qinlh/nxp/buildroot/dl"
# Linux headers same as kernel
BR2_PACKAGE_HOST_LINUX_HEADERS_CUSTOM_5_4=y

# bootloader
BR2_TARGET_UBOOT=y
BR2_TARGET_UBOOT_CUSTOM_REPO_URL="/home/qinlh/media_qinlh/nxp/LSDK-20.12/u-boot/.git"
BR2_TARGET_UBOOT_CUSTOM_REPO_VERSION="myd-jls1028"
BR2_TARGET_UBOOT_VERSION="myd-jls1028"
BR2_TARGET_UBOOT_BOARDNAME="ls1028ardb_tfa"
BR2_TARGET_UBOOT_CUSTOM_GIT=y
BR2_TARGET_UBOOT_NEEDS_DTC=y
BR2_TARGET_UBOOT_FORMAT_BIN=n
BR2_TARGET_UBOOT_FORMAT_CUSTOM=y
BR2_TARGET_UBOOT_FORMAT_CUSTOM_NAME="u-boot-dtb.bin"
BR2_TARGET_UBOOT_ENVIMAGE=y
BR2_TARGET_UBOOT_ENVIMAGE_SOURCE="board/myir/myd-jls1028/u-boot-environment-xspi.txt"
BR2_TARGET_UBOOT_ENVIMAGE_SIZE="0x2000"

# Kernel
BR2_LINUX_KERNEL=y
BR2_LINUX_KERNEL_CUSTOM_GIT=y
BR2_LINUX_KERNEL_CUSTOM_REPO_URL="/home/qinlh/media_qinlh/nxp/rt-linux/.git"
BR2_LINUX_KERNEL_CUSTOM_REPO_VERSION="linux-5.4.y"
BR2_LINUX_KERNEL_VERSION="linux-5.4.y"
BR2_LINUX_KERNEL_USE_ARCH_DEFAULT_CONFIG=y
BR2_LINUX_KERNEL_CONFIG_FRAGMENT_FILES="$(LINUX_DIR)/arch/arm64/configs/lsdk.config"
BR2_LINUX_KERNEL_DTS_SUPPORT=y
BR2_LINUX_KERNEL_INTREE_DTS_NAME="freescale/fsl-ls1028a-rdb"
BR2_LINUX_KERNEL_IMAGE_TARGET_CUSTOM=y
BR2_LINUX_KERNEL_IMAGE_TARGET_NAME="Image.gz"
BR2_LINUX_KERNEL_NEEDS_HOST_OPENSSL=y

# Serial port config
BR2_TARGET_GENERIC_GETTY=y
BR2_TARGET_GENERIC_GETTY_PORT="ttyS0"

# required tools to create the microSD image
BR2_PACKAGE_HOST_DOSFSTOOLS=y
BR2_PACKAGE_HOST_GENIMAGE=y
BR2_PACKAGE_HOST_MTOOLS=y
BR2_ROOTFS_POST_IMAGE_SCRIPT="board/myir/myd-jls1028/post-image-spi.sh"
BR2_ROOTFS_POST_SCRIPT_ARGS="$(LINUX_DIR) $(TOPDIR) $(UBOOT_DIR)"

# busybox setting
BR2_PACKAGE_BUSYBOX_CONFIG_FRAGMENT_FILES="board/myir/common/ls/busybox.config"
BR2_PACKAGE_BUSYBOX_SHOW_OTHERS=y

# packages for rcw
BR2_PACKAGE_HOST_QORIQ_RCW=y
BR2_PACKAGE_HOST_QORIQ_RCW_BOOT_MODE="flexspi_nor"
BR2_PACKAGE_HOST_QORIQ_RCW_BIN="myd_jls1028/R_SQPP_0x85bb/rcw_1500_gpu600.bin"
BR2_PACKAGE_HOST_QORIQ_RCW_SITE="/home/qinlh/media_qinlh/nxp/LSDK-20.12/rcw/.git"
BR2_PACKAGE_HOST_QORIQ_RCW_VERSION="myd-jls1028"

#eudev support
BR2_ROOTFS_DEVICE_CREATION_DYNAMIC_EUDEV=y
BR2_ROOTFS_OVERLAY="board/myir/myd-jls1028/rootfs_overlay board/myir/common/ls/busybox_init_overlay"

# Arm-Trusted-Firmware
BR2_TARGET_ARM_TRUSTED_FIRMWARE=y
BR2_TARGET_ARM_TRUSTED_FIRMWARE_FIP=y
BR2_TARGET_ARM_TRUSTED_FIRMWARE_UBOOT_AS_BL33=y
BR2_TARGET_ARM_TRUSTED_FIRMWARE_UBOOT_BL33_IMAGE="u-boot-dtb.bin"
BR2_TARGET_ARM_TRUSTED_FIRMWARE_CUSTOM_GIT=y
BR2_TARGET_ARM_TRUSTED_FIRMWARE_VERSION="myd-jls1028"
BR2_TARGET_ARM_TRUSTED_FIRMWARE_CUSTOM_REPO_URL="/home/qinlh/media_qinlh/nxp/LSDK-20.12/atf/.git"
BR2_TARGET_ARM_TRUSTED_FIRMWARE_CUSTOM_REPO_VERSION="myd-jls1028"
BR2_TARGET_ARM_TRUSTED_FIRMWARE_PLATFORM="myd_jls1028"
BR2_TARGET_ARM_TRUSTED_FIRMWARE_IMAGES="fip.bin bl2_flexspi_nor.pbl"
BR2_TARGET_ARM_TRUSTED_FIRMWARE_ADDITIONAL_TARGETS="pbl"
BR2_TARGET_ARM_TRUSTED_FIRMWARE_ADDITIONAL_DEPENDENCIES="host-qoriq-rcw"
BR2_TARGET_ARM_TRUSTED_FIRMWARE_ADDITIONAL_VARIABLES="BOOT_MODE=flexspi_nor RCW=$(BINARIES_DIR)/rcw_1500_gpu600.bin"

#Display port firmware
BR2_PACKAGE_QORIQ_CADENCE_DP_FIRMWARE=y

# qoriq-ptp4l package
BR2_PACKAGE_QORIQ_PTP4L=y

# qoriq-tsntool
BR2_PACKAGE_CJSON=y
BR2_PACKAGE_QORIQ_TSNTOOL=y
BR2_PACKAGE_QORIQ_TSN_SCRIPTS=y


# sysrepo-tsn
BR2_PACKAGE_QORIQ_SYSREPO_TSN=y

# qoriq-genavb-tsn-bridge
BR2_PACKAGE_QORIQ_GENAVB_TSN_BRIDGE=y

# basic packages and tools
BR2_PACKAGE_MTD=y
BR2_PACKAGE_MTD_MTD_DEBUG=y
BR2_PACKAGE_SYSSTAT=y
BR2_PACKAGE_E2FSPROGS=y
BR2_PACKAGE_RT_TESTS=y
BR2_PACKAGE_OPENSSH=y
BR2_PACKAGE_OPENSSL=y
BR2_PACKAGE_WGET=y

# ca-certs packages
BR2_PACKAGE_CA_CERTIFICATES=y

# dhcpd package
BR2_PACKAGE_DHCPCD=y

# resize2fs package
BR2_PACKAGE_E2FSPROGS_RESIZE2FS=y

# Text editors
BR2_PACKAGE_NANO=y

# IGH ETHERCAT
BR2_PACKAGE_IGH_ETHERCAT=y

#iproute2
BR2_PACKAGE_IPROUTE2=y
BR2_PACKAGE_LIBMNL=y

#netperf
BR2_PACKAGE_NETPERF=y

BR2_PACKAGE_ETHTOOL=y
BR2_PACKAGE_COLLECTD_CURL=y
BR2_PACKAGE_COLLECTD_CURL_JSON=y
BR2_PACKAGE_COLLECTD_CURL_XML=y
BR2_PACKAGE_LIBCURL=y
BR2_PACKAGE_LIBCURL_CURL
BR2_PACKAGE_LIBCURL_VERBOSE=y
BR2_PACKAGE_FLICKCURL=y
BR2_PACKAGE_FLICKCURL_UTILS=y
BR2_PACKAGE_BASH=y
BR2_SYSTEM_BIN_SH_BASH=y
BR2_SYSTEM_BIN_SH="bash"

# i2c-tools
BR2_PACKAGE_I2C_TOOLS=y

# haveged
BR2_PACKAGE_HAVEGED=y

BR2_PACKAGE_ALSA_UTILS=y
BR2_PACKAGE_ALSA_UTILS_AMIXER=y
BR2_PACKAGE_ALSA_UTILS_APLAY=y
BR2_PACKAGE_SPIDEV_TEST=y
BR2_PACKAGE_MEMTESTER=y
BR2_PACKAGE_MINICOM=y
BR2_PACKAGE_UBOOT_TOOLS=y
BR2_PACKAGE_BLUEZ_TOOLS=y
BR2_PACKAGE_BLUEZ5_UTILS=y
BR2_PACKAGE_HOSTAPD=y
BR2_PACKAGE_PPPD=y
BR2_PACKAGE_WIRELESS_TOOLS=y
BR2_PACKAGE_WPA_SUPPLICANT=y
BR2_PACKAGE_PCIUTILS=y
```
